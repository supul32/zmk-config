## config/arm/my60ble/Kconfig.defconfig
```kconfig
# Copyright (c) 2020 The ZMK Contributors
# SPDX-License-Identifier: MIT

if BOARD_MY60BLE

config BOARD
    default "my60ble"

config ZMK_KEYBOARD_NAME
    default "My 60% BLE"

if USB

config USB_NRFX
    default y

config USB_DEVICE_STACK
    default y

endif # USB

config BT_CTLR
    default BT

config ZMK_BLE
    default y

config ZMK_USB
    default y

config ZMK_BATTERY_REPORT_INTERVAL
    default 60

endif # BOARD_MY60BLE
```
